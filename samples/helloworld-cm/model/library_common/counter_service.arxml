AUTOSAR XML (schema 00049)
package /CounterInterfaces
  service interface CounterService: major-version=1, minor-version=0
    namespaces:
      symbol props demo
      symbol props counter
    events:
      data CounterChanged: type=uint32_t
    methods:
      operation GetCounter
        arg value: type=uint32_t, direction=OUT
package /CounterSomeipDeployments
  someip service interface deployment CounterService: service-interface=CounterService, service-interface-id=102, service-interface-version={major-version=1, minor-version=0}
    someip event deployment CounterChanged: event=CounterChanged, event-id=0x0001, transport-protocol=UDP
    someip method deployment GetCounter: method=GetCounter, method-id=1, transport-protocol=UDP
    someip event group Eventgroup1: event-group-id=1, event=CounterChanged
