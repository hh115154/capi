AUTOSAR XML (schema 00049)
package /Client2Deployment
  process to machine mapping set mappingSet
    process to machine mapping Client2Mapping: machine=Machine1, process=client2_process
  dlt log channel to process mapping dltLogChannelToProcessMapping1_client2_default: dlt-log-channel=default, process=client2_process
  dlt log channel to process mapping dltLogChannelToProcessMapping1_client2_com: dlt-log-channel=com, process=client2_process
  dlt log channel to process mapping dltLogChannelToProcessMapping1_client2_nai: dlt-log-channel=nai, process=client2_process
  someip service instance to machine mapping ServiceHelloWorld_RequiredServiceInstance_toMachine: communication-connector=CommunicationConnector1, service-instance=RequiredInstanceServiceHelloWorldClient2
  process client2_process: design=Client2Design, executable=client2d, state-dependent-startup-config{function-group-state=[HelloWorldGroup.Driving, HelloWorldGroup.Parking], resource-group=DefaultResourceGroup, startup-config=client2_config}
    process state machine processStatMachine: type=ProcessStateMachine
  startup config set startup_set
    startup config client2_config: environment-variables=tag-with-optional-value={key=proxy, value=192.168.1.2}, scheduling-policy=RR, scheduling-priority=12, termination-behavior=PROCESS-IS-SELF-TERMINATING
  service instance to port prototype mapping ServiceHelloWorld_RequiredServiceInstance_toPort: port-prototype=client2.helloworld_RPort, process-design=Client2Design, process=client2_process, service-instance=RequiredInstanceServiceHelloWorldClient2
package /Grant
  com find service grant client2_findservicegrant: service-instance=RequiredInstanceServiceHelloWorldClient2
  com method grant client2_echomethodgrant: service-instance=RequiredInstanceServiceHelloWorldClient2, service-deployment=EchoMethod
  com event grant client2_testeventgrant: service-instance=RequiredInstanceServiceHelloWorldClient2, service-deployment=testEvent
