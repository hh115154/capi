AUTOSAR XML (schema 00049)
package /ISOFT/Development/SoftwareClusters1/VER_100
  software cluster CMDemo_client: category=APPLICATION_LAYER, claimed-function-group=HelloWorldGroup, contained-ar-element=[clientd, client2d], contained-process=[client_process, client2_process], type-approval=e1*2024/123*4567*89, vendor-id=1, version=1.1.0
