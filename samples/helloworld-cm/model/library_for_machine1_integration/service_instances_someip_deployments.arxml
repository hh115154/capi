AUTOSAR XML (schema 00049)
package /SomeipInstancesDeployments
  provided someip service instance ProvidedInstanceServiceHelloWorld: service-interface-deployment=ServiceHelloWorld, service-instance-id=29
    someip provided event group ProvidedEventgroup1: event-group=Eventgroup1, multicast-threshold=0
  required someip service instance RequiredInstanceServiceHelloWorld: service-interface-deployment=ServiceHelloWorld, required-minor-version=0, required-service-instance-id=29, version-driven-find-behavior=MINIMUM-MINOR-VERSION
    someip required event group RequiredEventgroup1: event-group=Eventgroup1
  required someip service instance RequiredInstanceServiceHelloWorldClient2: service-interface-deployment=ServiceHelloWorld, required-minor-version=0, required-service-instance-id=29, version-driven-find-behavior=MINIMUM-MINOR-VERSION
    someip required event group RequiredEventgroup1: event-group=Eventgroup1
