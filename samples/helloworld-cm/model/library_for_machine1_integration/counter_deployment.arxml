AUTOSAR XML (schema 00049)
package /CounterDeployment1
  required someip service instance RequiredCounter: service-interface-deployment=CounterService, required-minor-version=0, required-service-instance-id=1, version-driven-find-behavior=MINIMUM-MINOR-VERSION
    someip required event group RequiredEventgroup1: event-group=Eventgroup1
  someip service instance to machine mapping Counter_toMachine: communication-connector=CommunicationConnector1, service-instance=RequiredCounter
  service instance to port prototype mapping Counter_toPort: port-prototype=client2.counter_RPort, process-design=Client2Design, process=client2_process, service-instance=RequiredCounter
  com find service grant counter_find: service-instance=RequiredCounter
  com method grant counter_get: service-instance=RequiredCounter, service-deployment=GetCounter
  com event grant counter_event: service-instance=RequiredCounter, service-deployment=CounterChanged
package /ISOFT/Development
  machine Machine1
    iam module instantiation IamModuleInstantiation: grant=[counter_find, counter_get, counter_event]
