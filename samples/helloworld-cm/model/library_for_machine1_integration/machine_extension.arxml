AUTOSAR XML (schema 00049)
package /ISOFT/Development
  machine Machine1
    module-instantiations:
      iam module instantiation IamModuleInstantiation: grant=[client2_findservicegrant, client2_echomethodgrant, client2_testeventgrant]
      log and trace instantiation helloworld_client_log
        dlt log channel default: application-id=client, context-id=#DFT, log-trace-default-log-level=DEBUG, log-trace-file-path=/var/redirected/, log-trace-log-modes=[CONSOLE, FILE, NETWORK]
        dlt log channel com: application-id=client, context-id=#COM, log-trace-default-log-level=DEBUG, log-trace-file-path=/var/redirected/, log-trace-log-modes=[CONSOLE, FILE, NETWORK]
        dlt log channel nai: application-id=client, context-id=#NAI, log-trace-default-log-level=DEBUG, log-trace-file-path=/var/redirected/, log-trace-log-modes=[CONSOLE, FILE, NETWORK]
      log and trace instantiation helloworld_client2_log
        dlt log channel default: application-id=clt2, context-id=#DFT, log-trace-default-log-level=DEBUG, log-trace-file-path=/var/redirected/, log-trace-log-modes=[CONSOLE, FILE, NETWORK]
        dlt log channel com: application-id=clt2, context-id=#COM, log-trace-default-log-level=DEBUG, log-trace-file-path=/var/redirected/, log-trace-log-modes=[CONSOLE, FILE, NETWORK]
        dlt log channel nai: application-id=clt2, context-id=#NAI, log-trace-default-log-level=DEBUG, log-trace-file-path=/var/redirected/, log-trace-log-modes=[CONSOLE, FILE, NETWORK]
      log and trace instantiation helloworld_server_log
        dlt log channel default: application-id=server, context-id=#DFT, log-trace-default-log-level=DEBUG, log-trace-file-path=/var/redirected/, log-trace-log-modes=[CONSOLE, FILE, NETWORK]
        dlt log channel com: application-id=server, context-id=#COM, log-trace-default-log-level=DEBUG, log-trace-file-path=/var/redirected/, log-trace-log-modes=[CONSOLE, FILE, NETWORK]
        dlt log channel nai: application-id=server, context-id=#NAI, log-trace-default-log-level=DEBUG, log-trace-file-path=/var/redirected/, log-trace-log-modes=[CONSOLE, FILE, NETWORK]
