AUTOSAR XML (schema 00049)
package /CounterDeployment2
  provided someip service instance ProvidedCounter: service-interface-deployment=CounterService, service-instance-id=1
    someip provided event group ProvidedEventgroup1: event-group=Eventgroup1, multicast-threshold=0
  someip service instance to machine mapping Counter_toMachine: communication-connector=CommunicationConnector1, service-instance=ProvidedCounter, udp-port=5002
  service instance to port prototype mapping Counter_toPort: port-prototype=server.counter_PPort, process-design=ServerDesign, process=server_process, service-instance=ProvidedCounter
  com offer service grant counter_offer: service-instance=ProvidedCounter
  com event grant counter_event: service-instance=ProvidedCounter, service-deployment=CounterChanged
package /ISOFT/Development
  machine Machine2
    iam module instantiation IamModuleInstantiation: grant=[counter_offer, counter_event]
